## config/boards/shields/urchin/Kconfig.defconfig
```kconfig
# Copyright (c) 2022 The ZMK Contributors
# SPDX-License-Identifier: MIT

if SHIELD_urchin_LEFT

config ZMK_KEYBOARD_NAME
    default "urchin"

config ZMK_SPLIT_ROLE_CENTRAL
    default y

endif

if SHIELD_urchin_LEFT || SHIELD_urchin_RIGHT
config ZMK_SPLIT
    default y
endif
```

## config/boards/shields/urchin/Kconfig.shield
```kconfig
# Copyright (c) 2022 The ZMK Contributors
# SPDX-License-Identifier: MIT

config SHIELD_urchin_LEFT
    def_bool $(shields_list_contains,urchin_left)

config SHIELD_urchin_RIGHT
    def_bool $(shields_list_contains,urchin_right)
```

## config/west.yml
```yaml
manifest:
  remotes:
    # zmk official
    - name: zmkfirmware
      url-base: https://github.com/zmkfirmware
      # bravekarma
    - name: caksoylar
      url-base: https://github.com/caksoylar
      # kyek / duckyb
    - name: duckyb
      url-base: https://github.com/duckyb
    - name: infely
      url-base: https://github.com/infely  
  projects:
    - name: zmk
      remote: zmkfirmware
      revision: main
      import: app/west.yml
    - name: urchin-zmk-module
      remote: duckyb
      revision: main
    - name: nice-view-battery
      remote: infely
      revision: main
  self:
    path: config
```
